## packages/virgo-pycdm/virgo_pycdm-0.4.3.tar.gz/virgo_pycdm-0.4.3/common-cdm/common/Kconfig.projbuild
```kconfig
menu "Virgo common"
  choice
  prompt "Olimex board"
    config EBI_OLIMEX_GATEWAY
		  bool "Olimex gateway board"

    config EBI_OLIMEX_POE
		  bool "Olimex PoE board"
		  select ETH_RMII_CLK_OUTPUT_GPIO0
  endchoice
endmenu
```
